//端口定义
int lcd_ce=2;
int lcd_rst=3;
int sclk=4;
int sdin=5;
int lcd_dc=9;
const unsigned char font6x8[][6] ={ 
    { 0x00, 0x00, 0x00, 0x00, 0x00, 0x00 },   // sp 
    { 0x00, 0x00, 0x00, 0x2f, 0x00, 0x00 },   // ! 
    { 0x00, 0x00, 0x07, 0x00, 0x07, 0x00 },   // " 
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    { 0x14, 0x14, 0x14, 0x14, 0x14, 0x14 }    // horiz lines 
}; 

void lcd_write_byte(unsigned char dat, unsigned char command){ 
    unsigned char i; 
    digitalWrite( lcd_ce, LOW); // 使能lcd_ce = 0 
    if (command == 0){ 
      digitalWrite( lcd_dc, LOW);// 传送命令 lcd_dc = 0; 
    }else{ 
      digitalWrite( lcd_dc, HIGH);// 传送数据lcd_dc = 1; 
    } 

  for(i=0;i<8;i++){ 
    if(dat&0x80){ 
      digitalWrite( sdin, HIGH);//sdin = 1; 
    }else{ 
      digitalWrite( sdin, LOW);//sdin = 0; 
    } 
    digitalWrite( sclk, LOW);//sclk = 0; 
    dat = dat << 1; 
    digitalWrite( sclk, HIGH);//sclk = 1; 
  } 
  digitalWrite( lcd_ce, HIGH);//lcd_ce = 1; 
} 
void lcd_clear(void){ 
  unsigned int i; 
  lcd_write_byte(0x0c, 0);  
  lcd_write_byte(0x80, 0); 
  for (i=0; i<504; i++){ 
    lcd_write_byte(0, 1); 
  }    
} 
void lcd_init(void){ 
  //先设置为输出 
  pinMode(sclk,OUTPUT); 
  pinMode(sdin,OUTPUT);
  pinMode(lcd_dc,OUTPUT); 
  pinMode(lcd_ce,OUTPUT);
  pinMode(lcd_rst,OUTPUT);
    
  // 产生一个让lcd复位的低电平脉冲 
  digitalWrite( lcd_rst, LOW); 
    
  delayMicroseconds(1);
  digitalWrite( lcd_rst, HIGH); 
     
  // 关闭lcd 
  digitalWrite( lcd_ce, LOW); 
  delayMicroseconds(1);

  // 使能lcd 
  digitalWrite( lcd_ce, HIGH); //lcd_ce = 1; 
  delayMicroseconds(1); 
  lcd_write_byte(0x21, 0); // 使用扩展命令设置lcd模式 
  lcd_write_byte(0xc8, 0); // 设置偏置电压 
  lcd_write_byte(0x06, 0); // 温度校正 
  lcd_write_byte(0x13, 0); // 1:48 
  lcd_write_byte(0x20, 0); // 使用基本命令 
  lcd_clear();             // 清屏 
  lcd_write_byte(0x0c, 0); // 设定显示模式，正常显示 
         
  // 关闭lcd 
  digitalWrite( lcd_ce, LOW);  //lcd_ce = 0; 
} 
void lcd_set_xy(unsigned char x, unsigned char y){ 
  lcd_write_byte(0x40 | y, 0);// column 
  lcd_write_byte(0x80 | x, 0);// row 
} 
void lcd_write_char(unsigned char c){ 
  unsigned char line; 
  c -= 32; 
  for (line=0; line<6; line++){ 
    lcd_write_byte(font6x8[c][line], 1); 
  } 
} 
void lcd_write_english_string(unsigned char x,unsigned char y,char *s){ 
  lcd_set_xy(x,y); 
  while (*s){ 
    lcd_write_char(*s); 
    s++; 
  } 
} 

