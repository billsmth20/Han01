// nokia 5110 arduino驱动程序（中文，图形显示。超声波测距）
// 版本1.1
// 2010.6
//

//端口定义

int lcd_ce=2;
int lcd_rst=3;
int sclk=4;
int sdin=5;
int lcd_dc=6;
int inputpin=8;  // 定义超声波信号接收接口
int outputpin=9; // 定义超声波信号发出接口

void setup()
{
  pinMode(inputpin, INPUT);
  pinMode(outputpin, OUTPUT);
}
//

unsigned char boy_bmp[]=
{


0xff,0x01,0x81,0xc1,0xf1,0xf9,0xf9,0xfd,0xff,0xff,0xff,0xff,0xff,0xff,0xff,0xff,
0xff,0xfd,0xf9,0xf1,0xe1,0x81,0x01,0xff,0xff,0x00,0x1f,0x7f,0xff,0x3f,0x27,0x27,
0x27,0x27,0x3f,0x17,0x3f,0x27,0x27,0x27,0x27,0x3f,0xff,0x3f,0x1f,0x0f,0x00,0xff,
0xff,0xf0,0xfc,0xfc,0xfe,0xff,0xfe,0xfc,0xec,0xf8,0xfa,0x5a,0xfa,0xf8,0xec,0xfc,
0xfe,0xff,0xfe,0xfe,0xfc,0xf8,0xf0,0xff,

};

//


const unsigned char hzk[][24]={ 
//深
{0x08,0xf1,0x1a,0x40,0x56,0xca,0x46,0xf2,0xc6,0x4a,0x56,0x00,0x01,0x07,0x00,0x02,0x01,0x00,0x00,0x07,0x00,0x01,0x02,0x00,}, 
//入 
{0x00,0x00,0x00,0xc1,0x31,0x0e,0x30,0xc0,0x00,0x00,0x00,0x00,0x04,0x02,0x01,0x00,0x00,0x00,0x00,0x00,0x01,0x02,0x04,0x00,}, 
//互 
{0x02,0x02,0x82,0xfe,0x8a,0x8a,0x8a,0xfa,0x02,0x03,0x02,0x00,0x04,0x04,0x04,0x04,0x04,0x04,0x04,0x07,0x04,0x04,0x04,0x00,}, 
//动
{0x92,0x52,0x32,0x52,0x92,0x10,0x08,0xff,0x08,0x08,0xf8,0x00,0x03,0x01,0x01,0x01,0x05,0x02,0x01,0x04,0x04,0x06,0x01,0x00,},
//科
{0x8a,0x6a,0xfe,0x29,0x49,0x80,0x92,0xa4,0x80,0xff,0x40,0x00,0x01,0x00,0x07,0x00,0x00,0x00,0x00,0x00,0x00,0x07,0x00,0x00,},
//技
{0x44,0x44,0xff,0x24,0x00,0x64,0xa4,0x3f,0xa4,0x64,0x04,0x00,0x04,0x04,0x07,0x00,0x04,0x04,0x02,0x01,0x02,0x04,0x04,0x00,},
}; 
//

 
const unsigned char font6x8[][6] = 
{ 
    { 0x00, 0x00, 0x00, 0x00, 0x00, 0x00 },   // sp 
    { 0x00, 0x00, 0x00, 0x2f, 0x00, 0x00 },   // ! 
    { 0x00, 0x00, 0x07, 0x00, 0x07, 0x00 },   // " 
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    { 0x14, 0x14, 0x14, 0x14, 0x14, 0x14 }    // horiz lines 
}; 
  
void lcd_init(void) 
{ 
    //先设置为输出 
     pinMode(sclk,OUTPUT); 
     pinMode(sdin,OUTPUT);
     pinMode(lcd_dc,OUTPUT); 
     pinMode(lcd_ce,OUTPUT);
     pinMode(lcd_rst,OUTPUT);
    
    // 产生一个让lcd复位的低电平脉冲 
     digitalWrite( lcd_rst, LOW); 
    
     delayMicroseconds(1);
     digitalWrite( lcd_rst, HIGH); 
     
    // 关闭lcd 
     digitalWrite( lcd_ce, LOW); 
     delayMicroseconds(1);

    // 使能lcd 
     digitalWrite( lcd_ce, HIGH); //lcd_ce = 1; 
     delayMicroseconds(1); 
    lcd_write_byte(0x21, 0); // 使用扩展命令设置lcd模式 
    lcd_write_byte(0xc8, 0); // 设置偏置电压 
    lcd_write_byte(0x06, 0); // 温度校正 
    lcd_write_byte(0x13, 0); // 1:48 
    lcd_write_byte(0x20, 0); // 使用基本命令 
    lcd_clear();             // 清屏 
    lcd_write_byte(0x0c, 0); // 设定显示模式，正常显示 
         
    // 关闭lcd 
   digitalWrite( lcd_ce, LOW);  //lcd_ce = 0; 
} 
 
void lcd_clear(void) 
{ 
    unsigned int i; 
    lcd_write_byte(0x0c, 0);  
    lcd_write_byte(0x80, 0); 
    for (i=0; i<504; i++) 
      { 
        lcd_write_byte(0, 1); 
      }    
} 

void lcd_set_xy(unsigned char x, unsigned char y) 
{ 
    lcd_write_byte(0x40 | y, 0);// column 
    lcd_write_byte(0x80 | x, 0);// row 
} 
 
void lcd_write_char(unsigned char c) 
{ 
    unsigned char line; 
    c -= 32; 
    for (line=0; line<6; line++) 
    { 
        lcd_write_byte(font6x8[c][line], 1); 
    } 
} 
 
 
void lcd_write_english_string(unsigned char x,unsigned char y,char *s) 
{ 
    lcd_set_xy(x,y); 
    while (*s)  
    { 
     lcd_write_char(*s); 
     s++; 
    } 
} 
 
 
void lcd_write_byte(unsigned char dat, unsigned char command) 
{ 
    unsigned char i; 
   digitalWrite( lcd_ce, LOW); // 使能lcd_ce = 0 
    if (command == 0) 
    { 
     digitalWrite( lcd_dc, LOW);// 传送命令 lcd_dc = 0; 
    } 
    else 
    { 
      digitalWrite( lcd_dc, HIGH);// 传送数据lcd_dc = 1; 
    } 

  for(i=0;i<8;i++) 
  { 
     if(dat&0x80) 
     { 
        digitalWrite( sdin, HIGH);//sdin = 1; 
     } 
    else 
    { 
     digitalWrite( sdin, LOW);//sdin = 0; 
     } 
   digitalWrite( sclk, LOW);//sclk = 0; 
   dat = dat << 1; 
   digitalWrite( sclk, HIGH);//sclk = 1; 
  } 
    digitalWrite( lcd_ce, HIGH);//lcd_ce = 1; 
        
} 
 
                         
void lcd_write_chinese_string(unsigned char x, unsigned char y, 
                              unsigned char ch_with,unsigned char num, 
         unsigned char line,unsigned char row) 
{ 
    unsigned char i,n; 
    lcd_set_xy(x,y);                             //设置初始位置 
    for (i=0;i <24;i++)
    { 
       for (n=0; n <24;n++)
       {  
           if (n==ch_with)                      //写汉字的下半部分 
           { 
               if (i==0) lcd_set_xy(x,y+1); 
               else 
    { 
                  lcd_set_xy((x+(ch_with+row)*i),y+1); 
    } 
            } 
           lcd_write_byte(hzk[line+i][n],1); 
       } 
       i++; 
       lcd_set_xy((x+(ch_with+row)*i),y); 
    } 
} 
 
 
void lcd_draw_bmp_pixel(unsigned char x,unsigned char y,unsigned char *map, 
                        unsigned char pix_x,unsigned char pix_y) 
{ 
    unsigned int i,n; 
    unsigned char row; 
    if (pix_y%8==0) 
{ 
     row=pix_y/8;      //计算位图所占行数 
    } 
    else 
{ 
        row=pix_y/8+1; 
    } 
    for (n=0;n <24;n++)
    { 
       lcd_set_xy(x,y); 
        for(i=0; i <24;i++)
          { 
            lcd_write_byte(map[i+n*pix_x], 1); 
          } 
        y++;                         //换行 
    }       
} 


void loop()
{
   lcd_init();//初始化液晶     
   lcd_clear();//清屏 
  

   lcd_draw_bmp_pixel(30,0,boy_bmp,24,24);        //调入上面的图像
   lcd_write_english_string(4,2,"----");          //写入ascii字符
   lcd_write_english_string(55,2,"----"); 
   lcd_write_chinese_string(6,3,12,6,0,0);        //写入中文字符
   lcd_write_english_string(20,5,"arduino");      
   delay(5000);

   lcd_clear();                                  //清屏 

   lcd_write_english_string(0,0," --arduino-- ");
   lcd_write_english_string(0,2,"renge:");
   
   lcd_write_english_string(0,4,"design by kent"); 
   lcd_write_english_string(0,5,"    2010.6    "); 

  //以下进入超声波测距

   while(1)
  {
      digitalWrite(outputpin, LOW); // 使发出发出超声波信号接口低电平2μs
      delayMicroseconds(2);
      digitalWrite(outputpin, HIGH); // 使发出发出超声波信号接口高电平10μs，这里是至少10μs
      delayMicroseconds(10);
      digitalWrite(outputpin, LOW);    // 保持发出超声波信号接口低电平
      int distance = 2400;//pulsein(inputpin, HIGH);  // 读出脉冲时间
      distance= distance/58;           // 将脉冲时间转化为距离（单位：厘米）
         if(distance>120)              //如果距离大于120cm
        {
      
         lcd_write_english_string(35,2,"???"); //在(35, 2)坐标上显示“???”
        }
         else
        {
          lcd_write_english_string(60,2,"cm");     //如果小于120cm
          lcd_set_xy(35, 2);                       //在(35, 2)坐标上显示测出数值
          lcd_write_char( 0x30+distance/100); //显示百位数
          lcd_write_char( 0x30+distance/10);   //显示十位数
          lcd_write_char( 0x30+distance);       //显示个位数
        }

  }


}
